#define CLOCK 2
#define DATA 3
#define P1 4
#define P2 5
#define P3 6
#define P4 7
#define P5 8
#define P6 9
#define P7 10
#define P8 11



//lower case
int lowerToAscii [] = {
  0x00, 0x88, 0x00, 0x84, 0x82, 0x80, 0x81, 0x8a, 0x00, 0x89, 0x87, 0x85, 0x83, 0x09, 0x60, 0x00, 0x00, 0x00, 0x00, 0x00, 0x00, 0x71, 0x31, 
  0x00, 0x00, 0x00, 0x7a, 0x73, 0x61, 0x77, 0x32, 0x00, 0x00, 0x63, 0x78, 0x64, 0x65, 0x34, 0x33, 0x00, 0x00, 0x20, 0x76, 0x66, 0x74, 0x72, 
  0x35, 0x00, 0x00, 0x6e, 0x62, 0x68, 0x67, 0x79, 0x36, 0x00, 0x00, 0x00, 0x6d, 0x6a, 0x75, 0x37, 0x38, 0x00, 0x00, 0x2c, 0x6b, 0x69, 0x6f, 
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  0x00, 0x00, 0x00
};

//upper case
int upperToAscii [] = {
  0x00, 0x88, 0x00, 0x84, 0x82, 0x80, 0x81, 0x8a, 0x00, 0x89, 0x87, 0x85, 0x83, 0x09, 0x7e, 0x00, 0x00, 0x00, 0x00, 0x00, 0x00, 0x51, 0x21, 
  0x00, 0x00, 0x00, 0x5a, 0x53, 0x41, 0x57, 0x40, 0x00, 0x00, 0x43, 0x58, 0x44, 0x45, 0x24, 0x23, 0x00, 0x00, 0x20, 0x56, 0x46, 0x54, 0x52, 
  0x25, 0x00, 0x00, 0x4e, 0x42, 0x48, 0x47, 0x59, 0x5e, 0x00, 0x00, 0x00, 0x4d, 0x4a, 0x55, 0x26, 0x2a, 0x00, 0x00, 0x3c, 0x4b, 0x49, 0x4f, 
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  0x00, 0x00, 0x00
};

//KeyState
const int KS_NORMAL = 1;
const int KS_SHIFT = 2;
const int KS_RELEASE = 4;

int count =10;
char scanCode[12];
int nScanCode = 0;
int bitcount = 0;
int keyState = KS_NORMAL;
const int SHIFT_LEFT = 0x12;
const int SHIFT_RIGHT = 0x59;
const int KEY_RELEASE = 0xf0;

void setup() {
    pinMode(CLOCK, INPUT);
    attachInterrupt(digitalPinToInterrupt(CLOCK), onClock, RISING);
    pinMode(DATA, INPUT);
    pinMode(P1, OUTPUT);
    pinMode(P2, OUTPUT);
    pinMode(P3, OUTPUT);
    pinMode(P4, OUTPUT);
    pinMode(P5, OUTPUT);
    pinMode(P6, OUTPUT);
    pinMode(P7, OUTPUT);
    pinMode(P8, OUTPUT);
    Serial.begin(57600);
}

void sevenSegment(int output){
  int pins[] = {P1, P2, P3, P4, P5, P6, P7, P8};//{P8, P7, P6, P5, P4, P3, P2, P1};
  for(int i = 0; i < 8; i++){
    if ((output & 1) > 0)
      digitalWrite(pins[i], HIGH);
    else
      digitalWrite(pins[i], LOW);

    output >>= 1;
  }
}


void onClock(){
  
  //Serial.println("foo");
  //Clock in eleven bits
  //Store them as the current scan code.
  //Display them on the monitor
  int bit = digitalRead(DATA) ? 1 : 0;
  scanCode[count--] = (bit == 1)? '1' : '0';
  nScanCode |= bit << bitcount++;
  //Serial.println(count);
  if (count < 0){
    char s[1024];
    scanCode[11] = '\0';
    //Serial.println(scanCode);
    nScanCode &= 0x1fe; //Mask off the checkbits
    nScanCode >>= 1; //move after masked
    //Serial.println(keyState);
    bool send_char = true;
    if (nScanCode == KEY_RELEASE){
      //Serial.println("one");
      send_char = false;
      keyState |= KS_RELEASE;
    }
    else if ((keyState & KS_RELEASE) > 0){
      //Serial.println("two");
      send_char = false;
      keyState ^= KS_RELEASE;
      if (nScanCode == SHIFT_LEFT || nScanCode == SHIFT_RIGHT)
        keyState ^= KS_SHIFT;
    }
    else if (nScanCode == SHIFT_LEFT || nScanCode == SHIFT_RIGHT){
      //Serial.println("three");
      send_char = false;
      keyState |= KS_SHIFT;
    }
    //Serial.println(keyState);
    char c;
    if ((keyState & KS_SHIFT) > 0){
      c = upperToAscii[nScanCode];
    }
    else {
      c = lowerToAscii[nScanCode];
    }
    sprintf(s, "%s %.2x %.2x  %c", scanCode, nScanCode, keyState, c);

    if (send_char){
      Serial.println(s);
      switch(c){
        case '0':sevenSegment(0b10111101);break;//AsevenSegment(0b10110111); break;
        case '1':sevenSegment(0b10100000);break;
        case '2':sevenSegment(0b00111110);break;
        case '3':sevenSegment(0b10111010);break;
        case '4':sevenSegment(0b10100011);break;
        case '5':sevenSegment(0b10011011);break;
        case '6':sevenSegment(0b10001111);break;
        case '7':sevenSegment(0b10110000);break;
        case '8':sevenSegment(0b10111111);break;
        case '9':sevenSegment(0b10110011);break;
      }
    }
    //Serial.println("\n\n");
    count = 10;
    nScanCode = 0;
    bitcount = 0;
  }
}

void loop() {
  // put your main code here, to run repeatedly:
}
